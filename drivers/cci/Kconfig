## drivers/cci/Kconfig
```kconfig
#
# Compalcomm drivers
#

menuconfig CCI_DRIVERS
        tristate "Compalcomm drivers."                                                                              
        default y

if CCI_DRIVERS

source "drivers/cci/vibrator/Kconfig"
source "drivers/cci/leds/Kconfig"
source "drivers/cci/sensors/yamaha/Kconfig"
#source "drivers/cci/optmouse/Kconfig"
source "drivers/cci/easy_update/Kconfig"

endif
```

## drivers/cci/leds/Kconfig
```kconfig
config CCI_PMIC_LEDS_KEY
	tristate "MSM PMIC keypad backlight leds driver"
	default y
config CCI_PMIC_NLED
	tristate "MSM PMIC Notification LED driver"
	default y
config CCI_LED_AN32155A
	tristate "Panasonic AN32155A LED controller driver"
	default y
```

## drivers/cci/sensors/yamaha/Kconfig
```kconfig
source "drivers/cci/sensors/yamaha/accelerometer/Kconfig"
source "drivers/cci/sensors/yamaha/geomagnetic/Kconfig"
source "drivers/cci/sensors/yamaha/orientation/Kconfig"
```

## drivers/cci/vibrator/Kconfig
```kconfig
config CCI_PMIC_VIBRATOR
	tristate "MSM PMIC vibrator driver"
	default n

config CCI_SMEM_VIBRATOR
	tristate "CCI SMEM vibrator driver"
	default y
```
